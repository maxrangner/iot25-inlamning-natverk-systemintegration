## src/firmware/main/Kconfig.projbuild
```kconfig
menu "IoT25 configuration"

    config IOT25_WIFI_SSID
        string "Wi-Fi SSID"
        default "changeme"
        help
            The Wi-Fi network name.

    config IOT25_WIFI_PASSWORD
        string "Wi-Fi password"
        default "changeme"
        help
            The WiFi password. Saved in sdkconfig, which is gitignored.

    config IOT25_MQTT_BROKER_URI
        string "MQTT Broker"
        default "mqtts://192.168.50.150:8883"
        help
            Broker for MQTT. Must use mqtts://, there is no unencrypted fallback.

    config IOT25_MQTT_USERNAME
        string "MQTT username"
        default "esp32-c3-01"
        help
            Username in the broker's password file.

    config IOT25_MQTT_PASSWORD
        string "MQTT password"
        default "changeme"
        help
            The MQTT password. Saved in sdkconfig, which is gitignored.

endmenu
```
